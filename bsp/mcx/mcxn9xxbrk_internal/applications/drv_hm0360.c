
#include <rtthread.h>
#include <rtdevice.h>
#include "fsl_common.h"
#include "fsl_lpspi_edma.h"
#include "fsl_lpspi.h"

#define HM_CHIP_ADDR       (0x24)

#define HM_DEBUG		0
#if ( HM_DEBUG == 1 )
#include <stdio.h>
#define HM_TRACE	rt_kprintf
#else
#define HM_TRACE(...)
#endif

#define BSP_USING_CAM0
#define BSP_USING_CAM1


static  uint8_t hm0360_init_regtbl[][3]={
		{0x01,0x03,0x00},
		{0x03,0x00,0x0C},
		{0x03,0x02,0xF8},
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		{0x10,0x13,0x00},
		{0x10,0x14,(1<<3)|(1<<1)|(1<<0)},//VSYNC shift
		{0x10,0x18,0x00},
		{0x10,0x1D,0xCF},
		{0x10,0x1E,0x01},
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		{0x31,0x0B,0x10},
        
        //{0x31,0x0F,(0<<7)},           /* 8bit mode */
        
		{0x31,0x0F,(1<<6)},             /* 4bit mode  (1<<6):4bit, (1<<7):1bir (0) 8bit */

		{0x31,0x12,(1<<3)},             //pclk0_polarity, MSB or LSB 
		{0x31,0x13,0xA0},
		{0x31,0x14,0x67},
		{0x31,0x15,0x42},
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		{0x31,0x8C,0x00},
        
		//{0x35,0x00,((1<<0) | (1<<2))},   //CLK_TB divider 10.24 Contet swtich A registers
        {0x35,0x00,0x0A}, 
  
		{0x35,0x01,0x0A},
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		{0x35,0x59,0x30},
		//{0x35,0x5A,0x74},
		{0x35,0x5A,0x78},
		{0x35,0x5B,0x0A},
		{0x35,0x5C,0x77},
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		{0x01,0x00,0x01},
};



#define DEMO_LPSPI_EDMA_WATERMARK   4U
#define DEMO_LPSPI_EDMA_MAJOR_LINES 240U /* Must be integer counts! */

#define DEMO_LPSPI_RES_HORIZONTAL   320UL
#define DEMO_LPSPI_RES_VERTICAL     240UL
#define DEMO_LPSPI_PIX_SIZE         1U
#define DEMO_LPSPI_LINE_SIZE        (DEMO_LPSPI_RES_HORIZONTAL * DEMO_LPSPI_PIX_SIZE)
#define DEMO_LPSPI_BUFFER_SIZE      (DEMO_LPSPI_LINE_SIZE * DEMO_LPSPI_RES_VERTICAL)

typedef struct 
{
    struct rt_device            parent;
    struct rt_i2c_bus_device    *bus;
    uint8_t                     vsync_pin;
    uint8_t                     chip_addr;
    
    LPSPI_Type                  *LPSPIX;
    DMA_Type                    *DMAX;
    uint32_t                    rx_dma_ch;
    edma_handle_t               dma_rx_handle;
    dma_request_source_t        dma_req_src;
    const char                  *name;
    const char                  *i2c_bus_name;
}cam_device_t;


static  cam_device_t cam_obj[] =
{
#ifdef BSP_USING_CAM0
    {
        .vsync_pin = ((1*32)+11),
        .name = "cam0",
        .i2c_bus_name = "i2c0",
        .LPSPIX = LPSPI5,
        .DMAX = DMA1,
        .rx_dma_ch = 1,
        .dma_req_src = kDmaRequestMuxLpFlexcomm5Rx,
    },
#endif
#ifdef BSP_USING_CAM1
    {
        .vsync_pin = ((1*32)+22),
        .name = "cam1",
        .i2c_bus_name = "i2c1",
        .LPSPIX = LPSPI3,
        .DMAX = DMA1,
        .rx_dma_ch = 2,
        .dma_req_src = kDmaRequestMuxLpFlexcomm3Rx,
    },
#endif
};



static rt_err_t rt_hm_init(rt_device_t dev)
{    
    return RT_EOK;
}


static void pin_irq_vsync(void *args)
{
    cam_device_t *cam = args;
    
    if(cam->parent.rx_indicate)
    {
        cam->parent.rx_indicate((rt_device_t)args, 1);
    }
}

static void lpfc_edma_major_callback(edma_handle_t *handle, void *userData, bool transferDone, uint32_t tcds)
{
    cam_device_t *cam = (cam_device_t *)userData;
    
    if(userData == &cam_obj[0])
    {
      //  rt_kprintf("cam0_dma_done\r\n");
    }

    if(userData == &cam_obj[1])
    {
    //    rt_kprintf("cam1_dma_done\r\n");
    }
  //  DMA0->CH[cam_obj[0].rx_dma_ch].TCD_CSR |= DMA_TCD_CSR_DREQ_MASK;
}



uint32_t cam_start_xfer(rt_device_t dev, uint8_t *buf)
{
    
    cam_device_t *cam = (cam_device_t *)dev;
    /**
     * DMA configuration:
     * Each DMA request will read 4 bytes from LPSPI FIFO
     * Each major loop will copy frame to memory
     * Major loop interrup is not necessary if actual VSYNC is used.
     * DMA maximum supports 131072 (32768 * 4) bytes in a single major loop,
     * this code has no byte count limit by modifying the macro.
     */
    
    LPSPI_DisableDMA(cam->LPSPIX, kLPSPI_RxDmaEnable);
    EDMA_AbortTransfer(&cam->dma_rx_handle);
    
    
    edma_transfer_config_t dma_cfg;

    memset(&dma_cfg, 0x00, sizeof(dma_cfg));
    
    dma_cfg.srcAddr            = LPSPI_GetRxRegisterAddress(cam->LPSPIX);
    dma_cfg.srcTransferSize    = kEDMA_TransferSize1Bytes;
    dma_cfg.srcOffset          = 0;
    dma_cfg.destAddr           = (uint32_t)buf;
    dma_cfg.destTransferSize   = kEDMA_TransferSize4Bytes;
    dma_cfg.destOffset         = 4;
    dma_cfg.minorLoopBytes     = DEMO_LPSPI_EDMA_WATERMARK; /* NBYTES for each DMA request */
    dma_cfg.majorLoopCounts    = (DEMO_LPSPI_LINE_SIZE * DEMO_LPSPI_EDMA_MAJOR_LINES) / DEMO_LPSPI_EDMA_WATERMARK;
    dma_cfg.dstMajorLoopOffset = 0; /* !! DADDR is auto-incremented by hardware, no adjustment needed */

    EDMA_SetTransferConfig(cam->DMAX, cam->rx_dma_ch, &dma_cfg, NULL);
    EDMA_EnableChannelInterrupts(cam->DMAX, cam->rx_dma_ch, kEDMA_MajorInterruptEnable);

    uint32_t tcd_xfer_count = DEMO_LPSPI_RES_VERTICAL / DEMO_LPSPI_EDMA_MAJOR_LINES;

    if (tcd_xfer_count > 1) {
        /* Do not clear request after TCD completed, since we need this channel to be triggered again by request */
        cam->DMAX->CH[cam->rx_dma_ch].TCD_CSR &= ~(DMA_TCD_CSR_DREQ_MASK);
    }

    
    lpspi_slave_config_t slave_cfg;
    LPSPI_SlaveGetDefaultConfig(&slave_cfg);

    slave_cfg.bitsPerFrame       = 8U;
    slave_cfg.whichPcs           = kLPSPI_Pcs0;
    slave_cfg.dataOutConfig      = kLpspiDataOutTristate;
    slave_cfg.pcsFunc            = kLPSPI_PcsAsData;
    slave_cfg.pcsActiveHighOrLow = kLPSPI_PcsActiveHigh;
    slave_cfg.cpha         = kLPSPI_ClockPhaseSecondEdge;
    LPSPI_SlaveInit(cam->LPSPIX, &slave_cfg);
    LPSPI_Enable(cam->LPSPIX, false);
    LPSPI_SetFifoWatermarks(cam->LPSPIX, 0, DEMO_LPSPI_EDMA_WATERMARK - 1);
    LPSPI_FlushFifo(cam->LPSPIX, true, true);
    
    uint32_t tcr = cam->LPSPIX->TCR;

    tcr &= ~(LPSPI_TCR_CONT_MASK | LPSPI_TCR_CONTC_MASK | LPSPI_TCR_BYSW_MASK | LPSPI_TCR_TXMSK_MASK);
    tcr |= LPSPI_TCR_TXMSK(1);
    tcr |= LPSPI_TCR_BYSW(0);
    tcr |= LPSPI_TCR_PCS(0);
    tcr |= LPSPI_TCR_WIDTH(2);

    LPSPI_Enable(cam->LPSPIX, true);

    cam->LPSPIX->TCR = tcr;
    
    EDMA_StartTransfer(&cam->dma_rx_handle);
    LPSPI_EnableDMA(cam->LPSPIX, kLPSPI_RxDmaEnable);

    return RT_EOK;
}



static rt_err_t rt_hm_open(rt_device_t dev, rt_uint16_t oflag)
{
    int i;
    uint8_t val;
    rt_err_t ret;
    
    cam_device_t *cam = (cam_device_t *)dev;
    
    struct rt_i2c_bus_device* bus = cam->bus;
    
    uint8_t buf[2];
    
    buf[0] = 0x00;
    buf[1] = 0x00;
    rt_i2c_master_send(bus, HM_CHIP_ADDR, 0, buf, sizeof(buf));
    rt_i2c_master_recv(bus, HM_CHIP_ADDR, 0, buf, 1);
    
    if(buf[0] == 0x03)
    {
        rt_kprintf("hm0360 found!\r\n", buf[0]);
        
        for(int i=0; i<ARRAY_SIZE(hm0360_init_regtbl); i++)
        {
            rt_i2c_master_send(bus, HM_CHIP_ADDR, 0, &hm0360_init_regtbl[i][0], 3);
        }
    }
    else
    {
        rt_kprintf("hm0360 not found! val:0x%X\r\n", buf[0]);
    }
    

    /* CHn_MUX can not be set again if the specified request is in use. */
    /* Also, the existing requests should be cleared before setting to another channel */
    EDMA_SetChannelMux(cam->DMAX, cam->rx_dma_ch, cam->dma_req_src);
    EDMA_CreateHandle(&cam->dma_rx_handle, cam->DMAX, cam->rx_dma_ch);
    EDMA_SetCallback(&cam->dma_rx_handle, lpfc_edma_major_callback, cam);
    

    
    /* VSYNC */
    rt_pin_mode(cam->vsync_pin, PIN_MODE_INPUT); 
    rt_pin_attach_irq(cam->vsync_pin, PIN_IRQ_MODE_FALLING, pin_irq_vsync, dev);
    rt_pin_irq_enable(cam->vsync_pin, 1);
    

    
    return ret;
}




static rt_ssize_t rt_hm_read(rt_device_t dev, rt_off_t pos, void* buffer, rt_size_t size)
{
    cam_device_t *cam = (cam_device_t *)dev;
    return size;
}


static rt_ssize_t rt_hm_write(rt_device_t dev, rt_off_t pos, const void* buffer, rt_size_t size)
{
    uint8_t *val = (uint8_t *)buffer;
    return 0;
}

int rt_hw_hm0360_init(void)
{
    int i;
    
    for (i = 0; i < sizeof(cam_obj) / sizeof(cam_obj[0]); i++)
    {
        cam_obj[i].parent.type               = RT_Device_Class_Miscellaneous;
        cam_obj[i].parent.rx_indicate        = RT_NULL;
        cam_obj[i].parent.tx_complete        = RT_NULL;
        cam_obj[i].parent.init               = rt_hm_init;
        cam_obj[i].parent.open               = rt_hm_open;
        cam_obj[i].parent.close              = RT_NULL;
        cam_obj[i].parent.read               = rt_hm_read;
        cam_obj[i].parent.write              = rt_hm_write;
        cam_obj[i].parent.user_data          = RT_NULL;
        
        struct rt_i2c_bus_device *bus = rt_i2c_bus_device_find(cam_obj[i].i2c_bus_name);
        
        RT_ASSERT(bus != RT_NULL);
        
        cam_obj[i].bus = bus;
        cam_obj[i].chip_addr = HM_CHIP_ADDR;
        rt_device_register(&cam_obj[i].parent, cam_obj[i].name, RT_DEVICE_FLAG_RDWR);   
    }

    return RT_EOK;
}



