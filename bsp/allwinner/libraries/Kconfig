## bsp/allwinner/libraries/Kconfig
```kconfig
menuconfig RT_USING_SUNXI_HAL
    bool "HAL library from sunxi"
    default n

if RT_USING_SUNXI_HAL
    source "$BSP_DIR/../libraries/sunxi-hal/hal/source/uart/Kconfig"
    source "$BSP_DIR/../libraries/sunxi-hal/hal/source/ccmu/Kconfig"
    source "$BSP_DIR/../libraries/sunxi-hal/hal/source/dma/Kconfig"
    source "$BSP_DIR/../libraries/sunxi-hal/hal/source/gpio/Kconfig"
    source "$BSP_DIR/../libraries/sunxi-hal/hal/source/disp2/Kconfig"
    source "$BSP_DIR/../libraries/sunxi-hal/hal/source/sdmmc/Kconfig"
    source "$BSP_DIR/../libraries/sunxi-hal/hal/source/twi/Kconfig"
endif
```

## bsp/allwinner/libraries/drivers/Kconfig
```kconfig
menu "General Drivers Configuration"

menu "General Purpose UARTs"

menuconfig BSP_USING_UART1
    bool "Enable UART1"
    default n
    if BSP_USING_UART1
        config BSP_UART1_TXD_PIN
            int "uart1 TXD pin number"
            default 20
        config BSP_UART1_RXD_PIN
            int "uart1 RXD pin number"
            default 21
    endif

endmenu

config BSP_USING_WDT
    bool "Enable watchdog driver"
    default y

config BSP_USING_RTC
    bool "Enable rtc driver"
    default y

endmenu
```
